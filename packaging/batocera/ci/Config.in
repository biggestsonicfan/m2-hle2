## packaging/batocera/libretro-m2hle/Config.in
```kconfig
config BR2_PACKAGE_LIBRETRO_M2HLE
    bool "libretro-m2hle"
    depends on BR2_INSTALL_LIBSTDCPP
    depends on BR2_TOOLCHAIN_HAS_THREADS
    depends on BR2_PACKAGE_HAS_LIBGL || BR2_PACKAGE_HAS_LIBGLES
    help
      m2-hle, a high-level emulator of the Sega Model 2 arcade
      board, as a libretro core: Sonic The Fighters, Fighting
      Vipers, Virtua Fighter 2, Virtual-On and the rest of the
      Model 2 library. OpenGL 4.1 core on x86_64, OpenGL ES 3
      elsewhere.

      https://github.com/biggestsonicfan/m2-hle2

comment "LIBRETRO_M2HLE needs a toolchain w/ C++, threads and OpenGL or OpenGL ES"
    depends on !BR2_INSTALL_LIBSTDCPP || !BR2_TOOLCHAIN_HAS_THREADS || \
        (!BR2_PACKAGE_HAS_LIBGL && !BR2_PACKAGE_HAS_LIBGLES)
```
